#include <math.h>
#include <stdint.h>
#include <limits>
#include <algorithm>
#include "freertos/FreeRTOS.h"
#include "freertos/task.h"
#include "freertos/semphr.h"
#include <string>
#include <iostream>

namespace FAST_INFERENCE {

static constexpr double layer_2_weight[3][3][1][12] = {{{{-1.0, 1.0, -1.0, 1.0, -1.0, 1.0, 1.0, -1.0, 1.0, 1.0, 1.0, 1.0}}, {{-1.0, -1.0, 1.0, 1.0, -1.0, 1.0, -1.0, 1.0, 1.0, 1.0, -1.0, 1.0}}, {{-1.0, -1.0, 1.0, -1.0, 1.0, 1.0, -1.0, -1.0, -1.0, 1.0, 1.0, 1.0}}}, {{{-1.0, -1.0, 1.0, -1.0, 1.0, 1.0, 1.0, -1.0, -1.0, -1.0, -1.0, -1.0}}, {{1.0, 1.0, 1.0, 1.0, 1.0, 1.0, -1.0, 1.0, 1.0, -1.0, -1.0, 1.0}}, {{-1.0, -1.0, -1.0, -1.0, 1.0, 1.0, -1.0, 1.0, -1.0, 1.0, -1.0, 1.0}}}, {{{1.0, 1.0, -1.0, -1.0, -1.0, -1.0, -1.0, -1.0, 1.0, -1.0, -1.0, 1.0}}, {{1.0, -1.0, 1.0, -1.0, -1.0, 1.0, -1.0, -1.0, 1.0, 1.0, -1.0, 1.0}}, {{-1.0, -1.0, -1.0, -1.0, 1.0, -1.0, 1.0, -1.0, -1.0, -1.0, 1.0, 1.0}}}};
static constexpr double layer_2_bias[12] = {1.0, 1.0, -1.0, -1.0, -1.0, -1.0, -1.0, -1.0, -1.0, -1.0, -1.0, 1.0};
static constexpr double layer_3_bias[12] = {0.8009690642356873, 0.8700371980667114, -0.744092583656311, 0.8823457360267639, -0.16760055720806122, -0.9781261086463928, 0.8977767825126648, 0.98203444480896, -0.5368480086326599, -0.549680769443512, 0.8647998571395874, -1.015918254852295};
static constexpr double layer_3_scale[12] = {0.0037603997625410557, 0.003952574450522661, 0.007203102111816406, 0.003402998438104987, 0.005973531864583492, 0.0024457117542624474, 0.0038695724215358496, 0.0038230635691434145, 0.005605355836451054, 0.006113635376095772, 0.0033084063325077295, 0.0015858671395108104};
static constexpr double layer_6_weight[3][3][12][12] = {{{{-1.0, -1.0, -1.0, 1.0, -1.0, 1.0, -1.0, 1.0, -1.0, 1.0, 1.0, -1.0}, {1.0, -1.0, 1.0, -1.0, -1.0, 1.0, 1.0, 1.0, 1.0, -1.0, 1.0, -1.0}, {-1.0, -1.0, -1.0, -1.0, 1.0, 1.0, -1.0, -1.0, -1.0, -1.0, -1.0, -1.0}, {-1.0, 1.0, -1.0, -1.0, -1.0, -1.0, -1.0, -1.0, -1.0, -1.0, -1.0, -1.0}, {1.0, -1.0, 1.0, 1.0, -1.0, -1.0, -1.0, 1.0, -1.0, 1.0, 1.0, -1.0}, {-1.0, 1.0, -1.0, -1.0, 1.0, -1.0, -1.0, -1.0, -1.0, 1.0, 1.0, -1.0}, {1.0, 1.0, 1.0, 1.0, -1.0, 1.0, -1.0, 1.0, 1.0, 1.0, -1.0, 1.0}, {-1.0, 1.0, 1.0, 1.0, -1.0, -1.0, -1.0, 1.0, -1.0, 1.0, -1.0, 1.0}, {1.0, -1.0, -1.0, -1.0, 1.0, 1.0, 1.0, -1.0, -1.0, 1.0, 1.0, -1.0}, {-1.0, -1.0, -1.0, 1.0, 1.0, -1.0, 1.0, -1.0, -1.0, 1.0, -1.0, -1.0}, {-1.0, 1.0, -1.0, 1.0, -1.0, 1.0, -1.0, 1.0, -1.0, -1.0, 1.0, -1.0}, {1.0, 1.0, -1.0, -1.0, 1.0, 1.0, -1.0, -1.0, -1.0, -1.0, -1.0, -1.0}}, {{-1.0, 1.0, 1.0, -1.0, 1.0, 1.0, 1.0, 1.0, -1.0, 1.0, -1.0, 1.0}, {1.0, -1.0, 1.0, -1.0, 1.0, 1.0, 1.0, 1.0, 1.0, -1.0, -1.0, 1.0}, {-1.0, 1.0, 1.0, 1.0, -1.0, -1.0, -1.0, -1.0, -1.0, 1.0, -1.0, -1.0}, {-1.0, 1.0, 1.0, -1.0, -1.0, 1.0, 1.0, 1.0, 1.0, -1.0, -1.0, -1.0}, {-1.0, -1.0, 1.0, 1.0, -1.0, -1.0, -1.0, -1.0, -1.0, 1.0, -1.0, 1.0}, {-1.0, -1.0, 1.0, 1.0, -1.0, -1.0, 1.0, -1.0, -1.0, -1.0, -1.0, -1.0}, {-1.0, 1.0, -1.0, -1.0, 1.0, 1.0, -1.0, -1.0, 1.0, -1.0, -1.0, 1.0}, {-1.0, 1.0, -1.0, 1.0, -1.0, 1.0, 1.0, -1.0, 1.0, -1.0, 1.0, -1.0}, {-1.0, 1.0, 1.0, -1.0, -1.0, -1.0, 1.0, 1.0, -1.0, -1.0, -1.0, 1.0}, {1.0, -1.0, 1.0, -1.0, 1.0, -1.0, 1.0, 1.0, -1.0, 1.0, 1.0, -1.0}, {-1.0, 1.0, -1.0, -1.0, -1.0, -1.0, -1.0, 1.0, -1.0, -1.0, -1.0, 1.0}, {-1.0, -1.0, 1.0, 1.0, 1.0, 1.0, 1.0, -1.0, -1.0, 1.0, -1.0, -1.0}}, {{-1.0, -1.0, 1.0, -1.0, 1.0, 1.0, 1.0, 1.0, 1.0, 1.0, -1.0, 1.0}, {-1.0, -1.0, 1.0, -1.0, 1.0, 1.0, 1.0, 1.0, 1.0, 1.0, 1.0, 1.0}, {1.0, -1.0, -1.0, -1.0, -1.0, -1.0, -1.0, 1.0, -1.0, 1.0, -1.0, -1.0}, {-1.0, -1.0, -1.0, -1.0, -1.0, -1.0, -1.0, 1.0, -1.0, -1.0, 1.0, 1.0}, {1.0, 1.0, -1.0, 1.0, -1.0, -1.0, -1.0, 1.0, -1.0, 1.0, -1.0, -1.0}, {1.0, 1.0, -1.0, -1.0, -1.0, -1.0, -1.0, 1.0, -1.0, 1.0, -1.0, -1.0}, {1.0, -1.0, 1.0, -1.0, 1.0, 1.0, 1.0, 1.0, 1.0, 1.0, 1.0, 1.0}, {1.0, 1.0, -1.0, 1.0, 1.0, 1.0, -1.0, 1.0, -1.0, 1.0, -1.0, 1.0}, {-1.0, 1.0, 1.0, -1.0, -1.0, 1.0, -1.0, -1.0, -1.0, 1.0, -1.0, -1.0}, {1.0, 1.0, -1.0, -1.0, -1.0, -1.0, -1.0, -1.0, -1.0, 1.0, -1.0, 1.0}, {-1.0, -1.0, -1.0, -1.0, 1.0, 1.0, 1.0, 1.0, 1.0, 1.0, -1.0, 1.0}, {-1.0, -1.0, 1.0, 1.0, 1.0, -1.0, 1.0, -1.0, 1.0, 1.0, -1.0, 1.0}}}, {{{1.0, -1.0, -1.0, 1.0, 1.0, 1.0, -1.0, 1.0, -1.0, 1.0, 1.0, 1.0}, {1.0, 1.0, 1.0, 1.0, -1.0, 1.0, -1.0, 1.0, -1.0, 1.0, 1.0, -1.0}, {-1.0, -1.0, 1.0, -1.0, 1.0, 1.0, 1.0, 1.0, -1.0, -1.0, 1.0, 1.0}, {-1.0, 1.0, -1.0, -1.0, -1.0, 1.0, -1.0, 1.0, 1.0, 1.0, -1.0, -1.0}, {-1.0, 1.0, 1.0, -1.0, -1.0, 1.0, 1.0, 1.0, -1.0, 1.0, 1.0, 1.0}, {-1.0, -1.0, -1.0, -1.0, -1.0, 1.0, 1.0, 1.0, -1.0, -1.0, 1.0, -1.0}, {1.0, -1.0, -1.0, 1.0, 1.0, 1.0, 1.0, -1.0, 1.0, 1.0, 1.0, -1.0}, {-1.0, 1.0, 1.0, 1.0, 1.0, -1.0, 1.0, 1.0, 1.0, -1.0, -1.0, -1.0}, {-1.0, 1.0, 1.0, -1.0, -1.0, 1.0, -1.0, 1.0, -1.0, -1.0, 1.0, 1.0}, {-1.0, 1.0, 1.0, -1.0, 1.0, 1.0, 1.0, -1.0, -1.0, 1.0, -1.0, -1.0}, {-1.0, 1.0, -1.0, 1.0, 1.0, -1.0, 1.0, -1.0, -1.0, 1.0, -1.0, -1.0}, {1.0, -1.0, 1.0, -1.0, 1.0, 1.0, 1.0, -1.0, -1.0, 1.0, 1.0, 1.0}}, {{-1.0, 1.0, 1.0, -1.0, -1.0, 1.0, 1.0, -1.0, 1.0, -1.0, -1.0, 1.0}, {1.0, -1.0, -1.0, -1.0, -1.0, 1.0, 1.0, -1.0, -1.0, -1.0, -1.0, 1.0}, {-1.0, 1.0, 1.0, -1.0, -1.0, 1.0, 1.0, -1.0, -1.0, -1.0, 1.0, -1.0}, {1.0, -1.0, -1.0, -1.0, -1.0, -1.0, -1.0, 1.0, -1.0, -1.0, -1.0, -1.0}, {-1.0, 1.0, 1.0, 1.0, -1.0, 1.0, -1.0, -1.0, -1.0, 1.0, 1.0, -1.0}, {-1.0, 1.0, 1.0, 1.0, 1.0, 1.0, 1.0, -1.0, 1.0, 1.0, 1.0, 1.0}, {1.0, 1.0, -1.0, 1.0, -1.0, -1.0, 1.0, 1.0, -1.0, -1.0, -1.0, 1.0}, {-1.0, -1.0, 1.0, 1.0, -1.0, 1.0, -1.0, -1.0, 1.0, 1.0, -1.0, -1.0}, {-1.0, -1.0, 1.0, -1.0, 1.0, 1.0, -1.0, -1.0, 1.0, -1.0, 1.0, 1.0}, {-1.0, -1.0, 1.0, -1.0, -1.0, 1.0, 1.0, 1.0, -1.0, 1.0, -1.0, 1.0}, {-1.0, 1.0, -1.0, -1.0, 1.0, 1.0, -1.0, 1.0, 1.0, 1.0, -1.0, -1.0}, {1.0, 1.0, 1.0, 1.0, 1.0, 1.0, 1.0, -1.0, 1.0, -1.0, 1.0, 1.0}}, {{1.0, -1.0, 1.0, -1.0, -1.0, -1.0, 1.0, 1.0, 1.0, -1.0, -1.0, -1.0}, {1.0, -1.0, -1.0, -1.0, 1.0, 1.0, 1.0, -1.0, -1.0, -1.0, -1.0, 1.0}, {-1.0, 1.0, -1.0, 1.0, -1.0, 1.0, -1.0, -1.0, 1.0, 1.0, -1.0, -1.0}, {-1.0, 1.0, -1.0, 1.0, -1.0, -1.0, 1.0, 1.0, -1.0, 1.0, -1.0, -1.0}, {-1.0, 1.0, -1.0, 1.0, -1.0, 1.0, -1.0, -1.0, 1.0, -1.0, 1.0, 1.0}, {1.0, 1.0, -1.0, 1.0, -1.0, 1.0, -1.0, 1.0, -1.0, -1.0, 1.0, -1.0}, {1.0, 1.0, -1.0, -1.0, -1.0, -1.0, 1.0, -1.0, -1.0, 1.0, -1.0, -1.0}, {1.0, 1.0, 1.0, -1.0, -1.0, -1.0, -1.0, 1.0, -1.0, -1.0, -1.0, -1.0}, {1.0, -1.0, 1.0, -1.0, -1.0, 1.0, -1.0, 1.0, -1.0, 1.0, -1.0, 1.0}, {1.0, 1.0, 1.0, -1.0, -1.0, 1.0, -1.0, -1.0, 1.0, 1.0, 1.0, -1.0}, {1.0, -1.0, 1.0, -1.0, -1.0, 1.0, 1.0, 1.0, 1.0, -1.0, -1.0, 1.0}, {1.0, 1.0, -1.0, 1.0, 1.0, -1.0, 1.0, 1.0, 1.0, 1.0, -1.0, 1.0}}}, {{{-1.0, 1.0, -1.0, 1.0, -1.0, 1.0, -1.0, 1.0, 1.0, -1.0, 1.0, 1.0}, {-1.0, -1.0, 1.0, -1.0, -1.0, 1.0, -1.0, -1.0, 1.0, -1.0, 1.0, -1.0}, {-1.0, -1.0, 1.0, -1.0, -1.0, 1.0, -1.0, 1.0, -1.0, 1.0, -1.0, 1.0}, {-1.0, -1.0, 1.0, 1.0, -1.0, -1.0, -1.0, -1.0, 1.0, -1.0, 1.0, -1.0}, {-1.0, 1.0, 1.0, -1.0, -1.0, 1.0, 1.0, -1.0, 1.0, 1.0, -1.0, 1.0}, {-1.0, 1.0, -1.0, -1.0, 1.0, 1.0, 1.0, 1.0, -1.0, 1.0, 1.0, 1.0}, {-1.0, 1.0, 1.0, 1.0, 1.0, -1.0, 1.0, 1.0, 1.0, 1.0, -1.0, -1.0}, {1.0, 1.0, 1.0, 1.0, 1.0, -1.0, 1.0, -1.0, 1.0, -1.0, 1.0, 1.0}, {1.0, -1.0, 1.0, -1.0, -1.0, 1.0, 1.0, 1.0, -1.0, -1.0, 1.0, -1.0}, {-1.0, -1.0, 1.0, -1.0, 1.0, 1.0, -1.0, 1.0, -1.0, -1.0, 1.0, 1.0}, {-1.0, 1.0, 1.0, 1.0, -1.0, 1.0, 1.0, -1.0, 1.0, -1.0, -1.0, -1.0}, {-1.0, -1.0, -1.0, 1.0, -1.0, 1.0, -1.0, -1.0, -1.0, -1.0, 1.0, 1.0}}, {{1.0, -1.0, 1.0, -1.0, 1.0, 1.0, 1.0, -1.0, -1.0, -1.0, -1.0, 1.0}, {1.0, -1.0, 1.0, -1.0, 1.0, 1.0, 1.0, -1.0, -1.0, 1.0, 1.0, -1.0}, {-1.0, 1.0, 1.0, -1.0, -1.0, 1.0, -1.0, 1.0, -1.0, 1.0, 1.0, 1.0}, {1.0, 1.0, 1.0, 1.0, -1.0, 1.0, 1.0, 1.0, 1.0, 1.0, -1.0, -1.0}, {-1.0, 1.0, 1.0, 1.0, -1.0, 1.0, -1.0, 1.0, 1.0, -1.0, 1.0, 1.0}, {-1.0, 1.0, 1.0, -1.0, -1.0, 1.0, -1.0, 1.0, 1.0, 1.0, 1.0, 1.0}, {1.0, 1.0, -1.0, -1.0, 1.0, 1.0, 1.0, -1.0, -1.0, -1.0, -1.0, -1.0}, {-1.0, 1.0, 1.0, 1.0, -1.0, -1.0, 1.0, -1.0, -1.0, 1.0, 1.0, -1.0}, {-1.0, -1.0, 1.0, -1.0, -1.0, -1.0, -1.0, 1.0, -1.0, -1.0, 1.0, 1.0}, {-1.0, 1.0, 1.0, -1.0, -1.0, 1.0, 1.0, 1.0, 1.0, -1.0, 1.0, -1.0}, {-1.0, 1.0, -1.0, 1.0, -1.0, 1.0, -1.0, 1.0, -1.0, -1.0, -1.0, -1.0}, {-1.0, -1.0, 1.0, -1.0, 1.0, -1.0, 1.0, 1.0, -1.0, -1.0, 1.0, 1.0}}, {{1.0, -1.0, -1.0, 1.0, 1.0, -1.0, 1.0, -1.0, -1.0, 1.0, -1.0, -1.0}, {1.0, -1.0, 1.0, -1.0, 1.0, 1.0, 1.0, -1.0, -1.0, 1.0, 1.0, 1.0}, {-1.0, 1.0, 1.0, 1.0, -1.0, -1.0, 1.0, 1.0, -1.0, 1.0, -1.0, 1.0}, {-1.0, -1.0, -1.0, 1.0, -1.0, 1.0, 1.0, -1.0, 1.0, -1.0, -1.0, 1.0}, {1.0, 1.0, -1.0, 1.0, -1.0, -1.0, -1.0, 1.0, -1.0, -1.0, 1.0, 1.0}, {1.0, 1.0, -1.0, 1.0, -1.0, -1.0, 1.0, 1.0, 1.0, -1.0, -1.0, 1.0}, {1.0, -1.0, 1.0, -1.0, 1.0, -1.0, 1.0, -1.0, 1.0, 1.0, -1.0, -1.0}, {1.0, 1.0, -1.0, -1.0, 1.0, -1.0, -1.0, -1.0, -1.0, 1.0, 1.0, -1.0}, {-1.0, 1.0, -1.0, -1.0, -1.0, 1.0, -1.0, 1.0, 1.0, 1.0, 1.0, 1.0}, {1.0, 1.0, -1.0, -1.0, -1.0, -1.0, 1.0, 1.0, 1.0, -1.0, -1.0, 1.0}, {1.0, -1.0, -1.0, -1.0, -1.0, -1.0, 1.0, -1.0, -1.0, 1.0, -1.0, -1.0}, {1.0, 1.0, 1.0, 1.0, -1.0, 1.0, 1.0, 1.0, 1.0, 1.0, 1.0, -1.0}}}};
static constexpr double layer_6_bias[12] = {1.0, -1.0, 1.0, -1.0, -1.0, -1.0, -1.0, 1.0, -1.0, 1.0, 1.0, -1.0};
static constexpr double layer_7_bias[12] = {0.2223123013973236, -0.2838575541973114, -0.3503037095069885, 0.21807320415973663, 0.454155296087265, -0.5205706357955933, 0.03613899648189545, -0.3823588788509369, 0.23742389678955078, -0.2701416313648224, 0.07907257974147797, 0.00033146142959594727};
static constexpr double layer_7_scale[12] = {0.06727037578821182, 0.07022495567798615, 0.08836869150400162, 0.056077949702739716, 0.06830106675624847, 0.10212178528308868, 0.0764014944434166, 0.07670353353023529, 0.05821498483419418, 0.0943462997674942, 0.05630473047494888, 0.06532537937164307};
static constexpr double layer_11_weight[12][300] = {{-1.0, 1.0, 1.0, 1.0, -1.0, -1.0, -1.0, -1.0, 1.0, 1.0, 1.0, -1.0, 1.0,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 -1.0, 1.0}, {-1.0, -1.0, 1.0, -1.0, 1.0, 1.0, -1.0, 1.0, -1.0, 1.0, 1.0, -1.0, 1.0,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 1.0, 1.0}, {1.0, 1.0, -1.0, -1.0, -1.0, -1.0, -1.0, -1.0, 1.0, -1.0, -1.0, -1.0, -1.0,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 -1.0, -1.0}, {-1.0, 1.0, 1.0, 1.0, -1.0, 1.0, -1.0, 1.0, -1.0, 1.0, -1.0, 1.0, -1.0,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 -1.0, 1.0}, {-1.0, 1.0, 1.0, 1.0, -1.0, 1.0, -1.0, 1.0, 1.0, 1.0, 1.0, 1.0, -1.0,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 1.0, -1.0}, {-1.0, 1.0, 1.0, 1.0, -1.0, 1.0, -1.0, -1.0, -1.0, 1.0, 1.0, 1.0, 1.0,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 1.0, 1.0}, {1.0, -1.0, -1.0, -1.0, 1.0, -1.0, -1.0, -1.0, 1.0, -1.0, -1.0, -1.0, 1.0,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 1.0, 1.0}, {-1.0, 1.0, -1.0, -1.0, 1.0, 1.0, 1.0, 1.0, -1.0, -1.0, -1.0, 1.0, 1.0,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 1.0, 1.0}, {1.0, 1.0, -1.0, 1.0, -1.0, -1.0, 1.0, 1.0, 1.0, 1.0, 1.0, -1.0, -1.0,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 1.0, 1.0}, {-1.0, 1.0, -1.0, 1.0, -1.0, 1.0, 1.0, 1.0, -1.0, 1.0, -1.0, 1.0, -1.0,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 -1.0, 1.0}, {-1.0, 1.0, 1.0, 1.0, -1.0, 1.0, -1.0, 1.0, 1.0, 1.0, 1.0, 1.0, -1.0,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 -1.0, 1.0}, {1.0, 1.0, -1.0, 1.0, 1.0, -1.0, 1.0, 1.0, 1.0, 1.0, -1.0, 1.0, 1.0,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 1.0, 1.0}};
static constexpr double layer_11_bias[12] = {1.0, 1.0, 1.0, 1.0, -1.0, 1.0, 1.0, -1.0, -1.0, -1.0, 1.0, 1.0};
static constexpr double layer_12_bias[12] = {-0.1705908179283142, 0.6134757399559021, -0.6541646122932434, -0.10181843489408493, 0.018505685031414032, 0.24309521913528442, 0.1500975489616394, 0.26876989006996155, -0.4844803810119629, -0.35187968611717224, 0.7822880744934082, -0.007422678172588348};
static constexpr double layer_12_scale[12] = {0.017465149983763695, 0.027045171707868576, 0.021002966910600662, 0.021688980981707573, 0.022892462089657784, 0.03179102763533592, 0.017587952315807343, 0.020000405609607697, 0.02077198028564453, 0.0234476700425148, 0.022510480135679245, 0.016824137419462204};
static constexpr double layer_14_weight[10][12] = {{1.0, 1.0, -1.0, 1.0, 1.0, 1.0, -1.0, 1.0, -1.0, -1.0, 1.0, -1.0}, {1.0, 1.0, 1.0, -1.0, 1.0, -1.0, -1.0, 1.0, 1.0, -1.0, -1.0, 1.0}, {-1.0, 1.0, 1.0, 1.0, 1.0, 1.0, 1.0, 1.0, 1.0, -1.0, 1.0, -1.0}, {1.0, -1.0, -1.0, 1.0, -1.0, 1.0, -1.0, 1.0, 1.0, 1.0, -1.0, 1.0}, {-1.0, -1.0, -1.0, -1.0, 1.0, 1.0, -1.0, 1.0, 1.0, -1.0, -1.0, 1.0}, {-1.0, -1.0, -1.0, -1.0, -1.0, -1.0, 1.0, -1.0, -1.0, -1.0, 1.0, -1.0}, {1.0, 1.0, -1.0, 1.0, 1.0, 1.0, 1.0, 1.0, -1.0, 1.0, 1.0, -1.0}, {-1.0, 1.0, -1.0, 1.0, -1.0, 1.0, 1.0, -1.0, -1.0, 1.0, -1.0, -1.0}, {-1.0, 1.0, -1.0, -1.0, -1.0, 1.0, 1.0, 1.0, -1.0, -1.0, 1.0, 1.0}, {-1.0, 1.0, -1.0, -1.0, -1.0, -1.0, 1.0, 1.0, -1.0, -1.0, -1.0, -1.0}};
static constexpr double layer_14_bias[10] = {1.0, -1.0, 1.0, 1.0, 1.0, -1.0, 1.0, 1.0, -1.0, -1.0};
  static double layer_2_output[26][26][12];
  static double layer_3_output[26][26][12];
  static double layer_4_output[26][26][12];
  static double layer_5_output[13][13][12];
  static double layer_6_output[11][11][12];
  static double layer_7_output[11][11][12];
  static double layer_8_output[11][11][12];
  //static double layer_9_output[5][5][12];
  //static double layer_11_output[12];
  //static double layer_12_output[12];
  //static double layer_13_output[12];
  //static double layer_14_output[10];
  //static double layer_15_output[10];
struct MaxPoolTaskParams
  {
    unsigned int hp;
    unsigned int wp;
    unsigned int cp;
    unsigned int kHp;
    unsigned int kWp;
    unsigned int prevWp;
    double *output;
    double *output_1;
    TaskHandle_t* taskHandels;
  };
  struct GemmTaskParams
  {
    unsigned int dp;
    unsigned int ip;
    double* output;
    double* output_1;
    const double* bias;
    const double* weight;
    TaskHandle_t* taskHandels;
  };
  struct ConvTaskParams
  {
    unsigned int hp;
    unsigned int wp;
    unsigned int mp;
    unsigned int kHp;
    unsigned int kWp;
    unsigned int cp;
    unsigned int prev_wp;
    double* output;
    double* output_1;
    const double* bias;
    const double* weight;
    TaskHandle_t* taskHandels;
  };
  struct BatchNormalization1DTaskParams
  {
    unsigned int dp;
    double* output;
    double* output_1;
    const double* scale;
    const double* bias;
    TaskHandle_t* taskHandels;
  };
  struct BatchNormalization3DTaskParams
  {
    unsigned int dp;
    unsigned int wp;
    unsigned int cp;
    double* output;
    double* output_1;
    const double* scale;
    const double* bias;
    TaskHandle_t* taskHandels;
  };
  struct Step1DTaskParams
  {
    unsigned int hp;
    double* output;
    double* output_1;
    TaskHandle_t* taskHandels;
  };
  struct Step3DTaskParams
  {
    unsigned int hp;
    unsigned int wp;
    unsigned int cp;
    double* output;
    double* output_1;
    TaskHandle_t* taskHandels;
  };
  struct LogSoftmaxTaskParams
  {
    unsigned int dp;
    double* output;
    double* output_1;
    double* pred;
    SemaphoreHandle_t mutex;
  };
  
  void ConvTask(void *params) {
    ConvTaskParams *taskParams = static_cast<ConvTaskParams *>(params);
    TaskHandle_t currentTaskHandle = xTaskGetCurrentTaskHandle();
    TaskHandle_t* layerHandles = taskParams->taskHandels;

    if(currentTaskHandle == layerHandles[4]) {
      ulTaskNotifyTake(pdTRUE, portMAX_DELAY);
    }
    else {
      vTaskDelay(1);
    }
    unsigned int hp = taskParams->hp;
    unsigned int wp = taskParams->wp;
    unsigned int mp = taskParams->mp;
    unsigned int kHp = taskParams->kHp;
    unsigned int kWp = taskParams->kWp;
    unsigned int cp = taskParams->cp;
    unsigned int prev_wp = taskParams->prev_wp;
    double *layer_p_output = taskParams->output;
    double *layer_p_previous_output = taskParams->output_1;
    const double *layer_p_bias = taskParams->bias;
    const double *layer_p_weight = taskParams->weight;
    unsigned int layer_p_index;
    
    for (int h = 0; h < hp; h++) {
      for (int w = 0; w < wp; w++) {
        for (int m = 0; m < mp; m++) {
          layer_p_index = (h * wp * mp) + (w * mp) + m;
          layer_p_output[layer_p_index] = layer_p_bias[m];
        }
        for (int kH = 0; kH < kHp; kH++) {
          for (int kW = 0; kW < kWp; kW++) {
            for (int c = 0; c < cp; c++) {
              for (int m = 0; m < mp; m++) {
                int weightIndex = (kH * kWp * cp * mp) + (kW * cp * mp) + (c * mp) + m;
                layer_p_index = (h * wp * mp) + (w * mp) + m;
                int layer_p_previous_index = ((h * 1 + kH - 0) * (prev_wp * cp)) + ((w * 1 + kW - 0) * cp) + c;
                layer_p_output[layer_p_index] += layer_p_weight[weightIndex] * layer_p_previous_output[layer_p_previous_index];
              }
            }
          }
        }
      }
    }
    if(currentTaskHandle == layerHandles[0]) {
      //printf("layer2 finished");
      xTaskNotifyGive(layerHandles[1]);
    }
    else {
      //printf("layer6 finished");
      xTaskNotifyGive(layerHandles[5]);
    }
    vTaskDelete(NULL);
  }  
  void BatchNormalization1DTask(void *params) {
    ulTaskNotifyTake(pdTRUE, portMAX_DELAY);
    BatchNormalization1DTaskParams *taskParams =  static_cast<BatchNormalization1DTaskParams *>(params);
    unsigned int dp = taskParams->dp;
    double *layer_p_output = taskParams->output;
    double *layer_p_previous_output = taskParams->output_1;
    const double *layer_p_scale = taskParams->scale;
    const double *layer_p_bias = taskParams->bias;
    TaskHandle_t* layerHandles = taskParams->taskHandels;

    for (int d = 0; d < dp; d++) {
      layer_p_output[d] = layer_p_previous_output[d] * layer_p_scale[d] + layer_p_bias[d];
    }
    //printf("layer12 finished");
    xTaskNotifyGive(layerHandles[10]);
    vTaskDelete(NULL);
  }

  void BatchNormalization3DTask(void *params) {
    ulTaskNotifyTake(pdTRUE, portMAX_DELAY);
    BatchNormalization3DTaskParams *taskParams = static_cast<BatchNormalization3DTaskParams *>(params);
    unsigned int dp = taskParams->dp;
    unsigned int wp = taskParams->wp;
    unsigned int cp = taskParams->cp;
    double *layer_p_output = taskParams->output;
    double *layer_p_previous_output = taskParams->output_1;
    const double *layer_p_scale = taskParams->scale;
    const double *layer_p_bias = taskParams->bias;
    TaskHandle_t* layerHandles = taskParams->taskHandels;

   for (int d = 0; d < dp; d++) {
      for (int w = 0; w < wp; w++) {
        for (int c = 0; c < cp; c++) {
          unsigned int layer_index = (d * wp * cp) + (w * cp) + c;
          layer_p_output[layer_index] = layer_p_previous_output[layer_index] * layer_p_scale[c] + layer_p_bias[c];
        }
      }
    }
    TaskHandle_t currentTaskHandle = xTaskGetCurrentTaskHandle();
    if(currentTaskHandle == layerHandles[1]) {
      //printf("layer3 finished");
      xTaskNotifyGive(layerHandles[2]);
    }
    else {
      //printf("layer7 finished");
      xTaskNotifyGive(layerHandles[6]);
    }
    vTaskDelete(NULL);
  }
  void Step1DTask(void *params) {
    ulTaskNotifyTake(pdTRUE, portMAX_DELAY);
    Step1DTaskParams *taskParams =  static_cast<Step1DTaskParams *>(params);
    unsigned int hp = taskParams->hp;
    double *layer_p_output = taskParams->output;
    double *layer_p_previous_output = taskParams->output_1;
    TaskHandle_t* layerHandles = taskParams->taskHandels;
  
    for (int h = 0; h < hp; h++) {
      layer_p_output[h] = layer_p_previous_output[h] > 0.0 ? 1.0 : -1.0;
    }
    //printf("layer13 finished");
    xTaskNotifyGive(layerHandles[11]);
    vTaskDelete(NULL);
  }

  void Step3DTask(void *params) {
    ulTaskNotifyTake(pdTRUE, portMAX_DELAY);
    Step3DTaskParams *taskParams =  static_cast<Step3DTaskParams *>(params);
    unsigned int hp = taskParams->hp;
    unsigned int wp = taskParams->wp;
    unsigned int cp = taskParams->cp;
    double *layer_p_output = taskParams->output;
    double *layer_p_previous_output = taskParams->output_1;
    TaskHandle_t* layerHandles = taskParams->taskHandels;
    TaskHandle_t currentTaskHandle = xTaskGetCurrentTaskHandle();
    
    for (int h = 0; h < hp; h++) {
      for (int w = 0; w < wp; w++) {
        for (int c = 0; c < cp; c++) {
          unsigned int layer_index = (h * wp * cp) + (w * cp) + c;
          layer_p_output[layer_index] = layer_p_previous_output[layer_index] > 0.0 ? 1.0 : -1.0;
        }
      }
    }
    if(currentTaskHandle == layerHandles[2]) {
      //printf("layer4 finished");
      xTaskNotifyGive(layerHandles[3]);
    }
    else {
      //printf("layer8 finished");
      xTaskNotifyGive(layerHandles[7]);
    }
    vTaskDelete(NULL);    
  }
void GemmTask(void *params) {
    ulTaskNotifyTake(pdTRUE, portMAX_DELAY);
    TaskHandle_t currentTaskHandle = xTaskGetCurrentTaskHandle();
    GemmTaskParams *taskParams = static_cast<GemmTaskParams *>(params);
    unsigned int dp = taskParams->dp;
    unsigned int ip = taskParams->ip;
    double *layer_p_output = taskParams->output;
    double *layer_p_previous_output = taskParams->output_1;
    const double *layer_p_bias = taskParams->bias;
    const double *layer_p_weight = taskParams->weight;
    TaskHandle_t* layerHandles = taskParams->taskHandels;
    
    if(currentTaskHandle == layerHandles[8]) {
      auto layer_10_output = (double *) layer_p_previous_output;
      for (int d = 0; d < dp; d++) {
      layer_p_output[d] = layer_p_bias[d];
      }
      for (int d = 0; d < dp; d++) {
        for (int i = 0; i < ip; i++) {
          int weightIndex = d * ip + i;
          layer_p_output[d] += layer_p_weight[weightIndex] * layer_10_output[i];
        }
      }
    }
    else {
      for (int d = 0; d < dp; d++) {
        layer_p_output[d] = layer_p_bias[d];
      }
      for (int d = 0; d < dp; d++) {
        for (int i = 0; i < ip; i++) {
          int weightIndex = d * ip + i;
          layer_p_output[d] += layer_p_weight[weightIndex] * layer_p_previous_output[i];
        }
      }
    }
    if(currentTaskHandle == layerHandles[8]) {
      //printf("layer11 finished");
      xTaskNotifyGive(layerHandles[9]);
    }
    else {
      //printf("layer14 finished");
      xTaskNotifyGive(layerHandles[12]);
    }
    vTaskDelete(NULL);
  }
  void MaxPoolTask(void *params) { 
    ulTaskNotifyTake(pdTRUE, portMAX_DELAY);
    MaxPoolTaskParams *maxPoolTaskParams = static_cast<MaxPoolTaskParams *>(params);
    unsigned int hp = maxPoolTaskParams->hp;
    unsigned int wp = maxPoolTaskParams->wp;
    unsigned int cp = maxPoolTaskParams->cp;
    unsigned int kHp = maxPoolTaskParams->kHp;
    unsigned int kWp = maxPoolTaskParams->kWp;
    unsigned int prevWp = maxPoolTaskParams->prevWp;
    double* layer_p_output = maxPoolTaskParams->output;
    double* layer_p_previous_output = maxPoolTaskParams->output_1;
    TaskHandle_t* layerHandles = maxPoolTaskParams->taskHandels;
    int p_output_index;
    int p_previous_output_index;
      for (int h = 0; h < hp; h++) {
        for (int w = 0; w < wp; w++) {
          for (int c = 0; c < cp; c++) {
            p_output_index = (h * wp * cp) + (w * cp) + c;
            layer_p_output[p_output_index] = std::numeric_limits<double>::lowest();
          }
          for (int kH = 0; kH < kHp; kH++) {
            for (int kW = 0; kW < kWp; kW++) {
              for (int c = 0; c < cp; c++) {
                p_output_index = (h * wp * cp) + (w * cp) + c;
                p_previous_output_index = (h * 2 + kH) * (prevWp * cp) + (w * 2 + kW) * cp + c;
                layer_p_output[p_output_index] = std::max(layer_p_previous_output[p_previous_output_index], layer_p_output[p_output_index]);
              }
            }
          }
        }
      }
    TaskHandle_t currentTaskHandle = xTaskGetCurrentTaskHandle();
    if(currentTaskHandle == layerHandles[3]) {
      //printf("layer5 finished");
      xTaskNotifyGive(layerHandles[4]);
    }
    else {
      //printf("layer9 finished");
      xTaskNotifyGive(layerHandles[8]);
    }
    vTaskDelete(NULL);
  }  
  void LogSoftmaxTask(void *params) {
    ulTaskNotifyTake(pdTRUE, portMAX_DELAY);
    LogSoftmaxTaskParams *taskParams = static_cast<LogSoftmaxTaskParams *>(params);
    unsigned int dp = taskParams->dp;
    double *layer_p_output = taskParams->output;
    double *layer_p_previous_output = taskParams->output_1;
    double *pred = taskParams->pred;
    SemaphoreHandle_t mutex = taskParams->mutex;
    double max = 0;
    for (int d = 0; d < dp; d++)
    {
      max = layer_p_previous_output[d] >= max ? layer_p_previous_output[d] : max;
    }
    double sum = 0;
    for (int d = 0; d < dp; d++)
    {
      layer_p_output[d] = std::exp(layer_p_previous_output[d] - max);
      sum += layer_p_output[d];
    }
    for (int d = 0; d < dp; d++)
    {
      layer_p_output[d] = std::log(layer_p_output[d] / sum);
    }
    for (int i = 0; i < dp; i++)
    {
      pred[i] += layer_p_output[i];
    }
    //printf("layer15 finished");
    xSemaphoreGive(mutex);
    vTaskDelete(NULL);
  }

void predict_SmallCnnActionBINARY5(double const * const x, double * pred) {
    //double layer_2_output[26][26][12];
    //double layer_3_output[26][26][12];
    //double layer_4_output[26][26][12];
    //double layer_5_output[13][13][12];
    //double layer_6_output[11][11][12];
    //double layer_7_output[11][11][12];
    //double layer_8_output[11][11][12];
    double layer_9_output[5][5][12];
    double layer_11_output[12];
    double layer_12_output[12];
    double layer_13_output[12];
    double layer_14_output[10];
    double layer_15_output[10];
    
    static SemaphoreHandle_t mutex;
    TaskHandle_t layer2Handle = NULL, layer3Handle = NULL, layer4Handle = NULL, layer5Handle = NULL, layer6Handle = NULL, layer7Handle = NULL, layer8Handle = NULL, layer9Handle = NULL, layer11Handle = NULL, layer12Handle = NULL, layer13Handle = NULL, layer14Handle = NULL, layer15Handle = NULL;
    TaskHandle_t taskHandleArray[13] = {layer2Handle, layer3Handle, layer4Handle, layer5Handle, layer6Handle, layer7Handle, layer8Handle, layer9Handle, layer11Handle, layer12Handle, layer13Handle, layer14Handle, layer15Handle};
    mutex = xSemaphoreCreateBinary();
    auto layer_0_output = x;
    auto layer_1_output = (double (*)[28][1]) layer_0_output;
    ConvTaskParams layer2params{26, 26, 12, 3, 3, 1, 28, &layer_2_output[0][0][0], &layer_1_output[0][0][0], const_cast<double *>(layer_2_bias), &layer_2_weight[0][0][0][0], taskHandleArray};
    BatchNormalization3DTaskParams layer3params{26, 26, 12, &layer_3_output[0][0][0], &layer_2_output[0][0][0], layer_3_scale, layer_3_bias, taskHandleArray};
    Step3DTaskParams layer4params{26, 26, 12, &layer_4_output[0][0][0], &layer_3_output[0][0][0], taskHandleArray};
    MaxPoolTaskParams layer5params{13, 13, 12, 2, 2, 26, &layer_5_output[0][0][0], &layer_4_output[0][0][0], taskHandleArray};
    ConvTaskParams layer6params{11, 11, 12, 3, 3, 12, 13, &layer_6_output[0][0][0], &layer_5_output[0][0][0], layer_6_bias, &layer_6_weight[0][0][0][0], taskHandleArray};
    BatchNormalization3DTaskParams layer7params{11, 11, 12, &layer_7_output[0][0][0], &layer_6_output[0][0][0], layer_7_scale, layer_7_bias, taskHandleArray};
    Step3DTaskParams layer8params{11, 11, 12, &layer_8_output[0][0][0], &layer_7_output[0][0][0], taskHandleArray};
    MaxPoolTaskParams layer9params{5, 5, 12, 2, 2, 11, &layer_9_output[0][0][0], &layer_8_output[0][0][0], taskHandleArray};
    GemmTaskParams layer11params{12, 300, layer_11_output, &layer_9_output[0][0][0], layer_11_bias, &layer_11_weight[0][0], taskHandleArray};
    BatchNormalization1DTaskParams layer12params{12, layer_12_output, layer_11_output, layer_12_scale, layer_12_bias, taskHandleArray};
    Step1DTaskParams layer13params{12, layer_13_output, layer_12_output, taskHandleArray};
    GemmTaskParams layer14params{10, 12, layer_14_output, layer_13_output, layer_14_bias, &layer_14_weight[0][0], taskHandleArray};
    LogSoftmaxTaskParams layer15params{10, layer_15_output, layer_14_output, pred, mutex};

    xTaskCreate(ConvTask, "Layer2", 2048, &layer2params, 1, &taskHandleArray[0]);
    xTaskCreate(BatchNormalization3DTask, "Layer3", 2048, &layer3params, 1, &taskHandleArray[1]);
    xTaskCreate(Step3DTask, "Layer4", 2048, &layer4params, 1, &taskHandleArray[2]);
    xTaskCreate(MaxPoolTask, "Layer5", 2048, &layer5params, 1, &taskHandleArray[3]);
    xTaskCreate(ConvTask, "Layer6", 2048, &layer6params, 1, &taskHandleArray[4]);
    xTaskCreate(BatchNormalization3DTask, "Layer7", 2048, &layer7params, 1, &taskHandleArray[5]);
    xTaskCreate(Step3DTask, "Layer8", 2048, &layer8params, 1, &taskHandleArray[6]);
    xTaskCreate(MaxPoolTask, "Layer9", 2048, &layer9params, 1, &taskHandleArray[7]);
    xTaskCreate(GemmTask, "Layer11", 2048, &layer11params, 1, &taskHandleArray[8]);
    xTaskCreate(BatchNormalization1DTask, "Layer12", 2048, &layer12params, 1, &taskHandleArray[9]);
    xTaskCreate(Step1DTask, "Layer13", 2048, &layer13params, 1, &taskHandleArray[10]);
    xTaskCreate(GemmTask, "Layer14", 2048, &layer14params, 1, &taskHandleArray[11]);
    xTaskCreate(LogSoftmaxTask, "Layer15", 2048, &layer15params, 1, &taskHandleArray[12]);
    xSemaphoreTake(mutex, portMAX_DELAY);
    vSemaphoreDelete(mutex);
  }
} 
